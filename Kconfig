## Kconfig
```kconfig
# Meteorite40 local Kconfig overrides

# Managed by release-please. Do not edit the version by hand.
# x-release-please-start-version
config ZMK_METEORITE_FIRMWARE_BUILD_VERSION
	default "4.6.0"
# x-release-please-end

if !ZMK_USB_LOGGING

config BOARD_SERIAL_BACKEND_CDC_ACM
	default n

config CONSOLE
	default n

config UART_CONSOLE
	default n

endif # !ZMK_USB_LOGGING
```

## boards/shields/meteorite40/Kconfig.defconfig
```kconfig
if SHIELD_METEORITE40

config ZMK_KEYBOARD_NAME
    default "meteorite40"

config CONSOLE
    default n

config UART_CONSOLE
    default n

endif
```

## boards/shields/meteorite40_low/Kconfig.defconfig
```kconfig
if SHIELD_METEORITE40_LOW

config ZMK_KEYBOARD_NAME
    default "meteorite40_low"

config CONSOLE
    default n

config UART_CONSOLE
    default n

endif
```
