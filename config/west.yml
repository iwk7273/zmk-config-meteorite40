## config/west.yml
```yaml
manifest:
  remotes:
    - name: zmkfirmware
      url-base: https://github.com/zmkfirmware
    - name: iwk7273
      url-base: https://github.com/iwk7273
  projects:
    - name: zmk
      remote: iwk7273
      revision: becdd178247af51706245968a5b87e1c55af75fe
      import: app/west.yml
    - name: zmk-pmw3610-driver
      remote: iwk7273
      revision: main
    - name: zmk-feature-meteorite-config
      remote: iwk7273
      revision: 028212e314ffaf175456b9630af5d8bf74ba05db
  self:
    path: config
```
